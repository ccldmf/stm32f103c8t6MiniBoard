## Core/Kconfig
```kconfig
config BSP_MODULES_LED_ENABLED
    bool "Enable BSP LED Modules"
    help
        Select this option to enable BSP LED Modules.

config BSP_MODULES_KEY_ENABLED
    bool "Enable BSP KEY Modules"
    help
        Select this option to enable BSP KEY Modules.
```

## Kconfig
```kconfig
mainmenu "STMicroelectronics CMake Project Configuration"

# BSP Modules configuration
menu "BSP Modules"
    osource "${PROJECT_PATH}/Core/Kconfig"
endmenu
```
